#pragma once

#include <Wire.h>
#include <Adafruit_GFX.h>
#include <Adafruit_SSD1306.h>
#include <Fonts/Picopixel.h>

#include "..\Menu\Menu.h"
#include "..\Screenspace\Effect.h"
#include "..\Signals\TimeStep.h"

class HeadsUpDisplay : public Effect {
private:
	static const uint16_t SCREEN_WIDTH = 128;
	static const uint16_t SCREEN_HEIGHT = 64;
	static const int8_t OLED_RESET = -1;
	static const uint8_t faceXMinPosition = 66;
	static const uint8_t faceXMaxPosition = 124;
	static const uint8_t faceYMinPosition = 35;
	static const uint8_t faceYMaxPosition = 60;
	static const uint32_t splashTime = 2500;
	static const int bufferSize = 2048;// 64 * 32

	const __FlashStringHelper* percentArray[10] = {F("10%"), F("20%"), F("30%"), F("40%"), F("50%"), F("60%"), F("70%"), F("80%"), F("90%"), F("100%")};
	const __FlashStringHelper* effectArray[10] = {F("NONE"), F("PHASEY"), F("PHASEX"), F("PHASER"), F("GLITCHX"), F("MAGNET"), F("FISHEYE"), F("BLURH"), F("BLURV"), F("BLURR")};
	const __FlashStringHelper* colorArray[10] = {F("GRDIENT"), F("YELLOW"), F("ORANGE"), F("WHITE"), F("GREEN"), F("PURPLE"), F("RED"), F("BLUE"), F("RAINBOW"), F("NOISE")};
	const __FlashStringHelper* onOffArray[2] = {F("OFFLINE"), F("ONLINE")};
	const __FlashStringHelper* mirrorSpecArray[2] = {F("DEFAULT"), F("MIRROR")};
	const __FlashStringHelper* hueArray[10] = {F("0 DEG"), F("36 DEG"), F("72 DEG"), F("108 DEG"), F("144 DEG"), F("180 DEG"), F("216 DEG"), F("252 DEG"), F("288 DEG"), F("324 DEG")};
	const __FlashStringHelper* faceArray[10] = {F("DEFAULT"), F("ANGRY"), F("DOUBT"), F("FROWN"), F("LOOKUP"), F("SAD"), F("AUDIO1"), F("AUDIO2"), F("AUDIO3")};
	const __FlashStringHelper** faceNames;
	bool useExternalFace = false;

	Effect* subEffect;// Effect that changes visuals in system
	TimeStep timeStep = TimeStep(5);
    bool didBegin = false;
	bool splashFinished = false;
	Vector2D faceMin;
	Vector2D faceMax;
	uint32_t startMillis;

	static Adafruit_SSD1306 display;

  	static uint8_t faceBitmap[bufferSize];

	static const uint8_t CoelaSplash[];
	static const uint8_t PrototracerSplash[];
	static const uint8_t FaceTemplate[];

	void ResetDisplayBuffer(){
		// Initialize the bitmap array to zero
		memset(faceBitmap, 0, sizeof(faceBitmap));
	}

	void EnableBitFaceRender(float xIn, float yIn){
		uint16_t x = Mathematics::ConstrainMap(xIn, faceMax.X, faceMin.X, 0.0f, float(faceXMaxPosition - faceXMinPosition));
		uint16_t y = Mathematics::ConstrainMap(yIn, faceMax.Y, faceMin.Y, 0.0f, float(faceYMaxPosition - faceYMinPosition));

		if (x >= 0 && x < 64 && y >= 0 && y < 32) {
			int byteIndex = y * 8 + (x / 8);
			int bitIndex = 7 - (x % 8);

			faceBitmap[byteIndex] |= (1 << bitIndex);

			//Serial.print(xIn); Serial.print('\t');
			//Serial.print(yIn); Serial.print('\t');
			//Serial.print(x); Serial.print('\t');
			//Serial.print(y); Serial.print('\t');
			//Serial.print(byteIndex); Serial.print('\t');
			//Serial.print(bitIndex); Serial.print('\t');
			//Serial.print(faceMax.ToString()); Serial.print('\t');
			//Serial.println(faceMin.ToString());;
		}
	}

	void UpdateFaceInformation(){
		display.clearDisplay();

		display.drawBitmap(0, 0, FaceTemplate, 128, 64, 1);

		display.setTextColor(0);        // Draw white text
		display.setTextSize(1);             // Normal 1:1 pixel scale

		//ROW 1
		display.setCursor(3,13);//Face
		if (useExternalFace) display.println(faceNames[Menu::GetFaceState()]);
		else display.println(faceArray[Menu::GetFaceState()]);
		
		display.setCursor(34,13);//Brightness
		display.println(percentArray[Menu::GetBrightness()]);

		display.setCursor(66,13);//Face Size
		display.println(percentArray[Menu::GetFaceSize()]);

		display.setCursor(98,13);//Use Microphone
		display.println(onOffArray[Menu::UseMicrophone()]);

		//ROW 2
		display.setCursor(3,28);//Effect
		display.println(effectArray[Menu::GetEffectS()]);

		display.setCursor(34,28);//Side Brightness
		display.println(percentArray[Menu::GetAccentBrightness()]);

		display.setCursor(66,28);//Face Color
		display.println(colorArray[Menu::GetFaceColor()]);

		display.setCursor(98,28);//Use Boop
		display.println(onOffArray[Menu::UseBoopSensor()]);

		//ROW 3
		display.setCursor(3,45);//Hue front
		display.println(hueArray[Menu::GetHueF()]);

		display.setCursor(34,45);//Mic level
		display.println(percentArray[Menu::GetMicLevel()]);

		//ROW 4
		display.setCursor(3,60);//Hue back
		display.println(hueArray[Menu::GetHueB()]);

		display.setCursor(34,60);//Mirror spectrum analyzer
		display.println(mirrorSpecArray[Menu::MirrorSpectrumAnalyzer()]);
		
  		display.drawBitmap(66, 35, faceBitmap, 64, 32, 0);
	}

public:
	HeadsUpDisplay(Vector2D faceMin, Vector2D faceMax){
		this->faceMin = faceMin;
		this->faceMax = faceMax;
	}

	void SetFaceArray(const __FlashStringHelper** faceNames){
		this->faceNames = faceNames;
		useExternalFace = true;
	}

	void SetFaceMin(Vector2D faceMin){
		this->faceMin = faceMin;
	}

	void SetFaceMax(Vector2D faceMax){
		this->faceMax = faceMax;
	}

	void Initialize(){
		ResetDisplayBuffer();
		
        Wire.begin();
        
        #ifdef WS35
        Wire.setSDA(19);
        Wire.setSCL(18);
        #else
        Wire.setSDA(18);
        Wire.setSCL(19);
        #endif

		Wire.beginTransmission(0x3C);
		uint8_t error = Wire.endTransmission();

		if(error == 0){// SSD1306 Found
			didBegin = display.begin(SSD1306_SWITCHCAPVCC, 0x3C);

			// Initialize the OLED display
			if (!didBegin) {
				// Handle initialization failure here
			}

			display.setFont(&Picopixel);

			// Clear the buffer and display
			display.clearDisplay();
			display.invertDisplay(true);
			display.display();
		}
		else {
			didBegin = false;
		}

		startMillis = millis();

	}

	void Update(){
		if (timeStep.IsReady() && didBegin){
			if (splashFinished){// Draw the bitmap to the display at the specified top-left coordinate
				UpdateFaceInformation();
			}
			else if (startMillis + splashTime > millis()){
				display.clearDisplay();
				display.drawBitmap(0, 0, CoelaSplash, SCREEN_WIDTH, SCREEN_HEIGHT, 1);
			}
			else if (startMillis + (splashTime * 2L) > millis()){
				display.clearDisplay();
				display.drawBitmap(0, 0, PrototracerSplash, SCREEN_WIDTH, SCREEN_HEIGHT, 1);
			}
			else{
				splashFinished = true;
			}
			
			display.display();
			ResetDisplayBuffer();
		}
	}

	void SetEffect(Effect* effect){
		this->subEffect = effect;
	}

	void ApplyEffect(IPixelGroup* pixelGroup){
		//Actually apply effect
		subEffect->ApplyEffect(pixelGroup);
		
        unsigned int pixelCount = pixelGroup->GetPixelCount();
		
		for (unsigned int i = 0; i < pixelCount; i++){
			Vector2D pixelLocation = pixelGroup->GetCoordinate(i);
			RGBColor color = *pixelGroup->GetColor(i);

			if(color.R > 0 || color.G > 0 || color.G > 0){
				EnableBitFaceRender(pixelLocation.X, pixelLocation.Y);
			}
        }
		
	}
};

Adafruit_SSD1306 HeadsUpDisplay::display(SCREEN_WIDTH, SCREEN_HEIGHT, &Wire, OLED_RESET);

uint8_t HeadsUpDisplay::faceBitmap[];

const uint8_t HeadsUpDisplay::CoelaSplash[] = {
0xFF, 0xFF, 0xFF, 0xFF, 0xF1, 0xFF, 0xFF, 0x7F, 0x1F, 0xFF, 0xFF, 0x43, 0x10, 0x00, 0x0F, 0xFF,
0xFF, 0xFF, 0xFF, 0xE1, 0xCF, 0x9F, 0xFF, 0xBB, 0xF7, 0xFF, 0xFE, 0x90, 0x70, 0x00, 0x07, 0xFF,
0xFF, 0xFF, 0xFF, 0x80, 0x3F, 0xBF, 0xFF, 0x97, 0xF9, 0xFF, 0xFE, 0xF8, 0x0E, 0x00, 0x03, 0xFF,
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0xFF, 0xFF, 0xFF, 0xFF, 0xFF, 0xFF, 0xFF, 0xFF, 0xFF, 0xFF, 0xFF, 0xFF, 0xFF, 0xFF, 0xFF, 0xFF
};

const uint8_t HeadsUpDisplay::PrototracerSplash [] = {
0xFF, 0xFF, 0xFF, 0xFF, 0xFF, 0xFF, 0xFF, 0xFF, 0xFF, 0xFF, 0xFF, 0xFF, 0xFF, 0xFF, 0xFF, 0xFF,
0xFF, 0xFF, 0xFF, 0xFF, 0xFF, 0xFF, 0xFF, 0xFF, 0xFF, 0xFF, 0xFF, 0xFF, 0xFF, 0xFF, 0xFF, 0xFF,
0xFF, 0xFF, 0xFF, 0xFF, 0xFF, 0xFF, 0xFF, 0xFF, 0xFF, 0xFF, 0xFF, 0xFF, 0xFF, 0xFF, 0xFF, 0xFF,
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0xFF, 0xFF, 0xFF, 0xFF, 0xFF, 0xFF, 0xFF, 0xFF, 0xFF, 0xFF, 0xFF, 0xFF, 0xFF, 0xFF, 0xFF, 0xFF
};

const uint8_t HeadsUpDisplay::FaceTemplate[] = {
0xFF, 0xFF, 0xFF, 0xFF, 0xFF, 0xFF, 0xFF, 0xFF, 0xFF, 0xFF, 0xFF, 0xFF, 0xFF, 0xFF, 0xFF, 0xFF,
0xC0, 0x00, 0x00, 0x01, 0x80, 0x00, 0x00, 0x01, 0x80, 0x00, 0x00, 0x01, 0x80, 0x00, 0x00, 0x03,
0xBF, 0xFF, 0xFF, 0xFE, 0x7F, 0xFF, 0xFF, 0xFE, 0x7F, 0xFF, 0xFF, 0xFE, 0x7F, 0xFF, 0xFF, 0xFD,
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0xFF, 0xFF, 0xFF, 0xFF, 0xFF, 0xFF, 0xFF, 0xFF, 0xFF, 0xFF, 0xFF, 0xFF, 0xFF, 0xFF, 0xFF, 0xFF
};